/**
 * @file    modbus_slave.c
 * @brief   Modbus RTU 从站 — RTX51 Tiny
 *
 * 架构:
 *   UART ISR:    SBUF → ring buffer (不丢字节)
 *   Modbus Task: t3.5 超时检测 → 帧处理 → 回复
 */

#include "modbus_slave.h"
#include "STC8G_H_GPIO.h"
#include "STC8G_H_Timer.h"
#include "i2c_cmd.h"
#include <string.h>

extern bit start_discharge_req, stop_discharge_req;
extern bit start_charge_req, stop_charge_req;
extern void SetChargeParamsByBatteryType(void);

/* Ring Buffer */
#define MB_RING_SIZE 256
static unsigned char  mb_ring[MB_RING_SIZE];
static volatile unsigned char mb_ring_wr, mb_ring_rd, mb_ring_count;
static unsigned long  mb_last_tick;
static unsigned char  mb_addr;
static unsigned char  mb_rx_buf[256], mb_tx_buf[256];

/* CRC */
static const unsigned char code crcHi[]={0x00,0xC1,0x81,0x40,0x01,0xC0,0x80,0x41,0x01,0xC0,0x80,0x41,0x00,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0x81,0x40};
static const unsigned char code crcLo[]={0x00,0xC0,0xC1,0x01,0xC3,0x03,0x02,0xC2,0xC6,0x06,0x07,0xC7,0x05,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0x80,0x40};
static unsigned short crc16(const unsigned char *b, unsigned char n){unsigned char h=0xFF,l=0xFF,i,x;for(i=0;i<n;i++){x=l^b[i];l=h^crcHi[x];h=crcLo[x];}return((unsigned short)h<<8)|l;}

static volatile bit mb_tx_done;
static void uart_putchar(unsigned char c){mb_tx_done=0;SBUF=c;while(!mb_tx_done);}
static void uart_send(const unsigned char *b,unsigned char n){unsigned char i;for(i=0;i<n;i++)uart_putchar(b[i]);}

static unsigned char write_reg(unsigned short a,unsigned short v){
    switch(a){
        case MB_REG_CMD:switch(v){case MB_CMD_START_DISCHARGE:start_discharge_req=1;break;case MB_CMD_STOP_DISCHARGE:stop_discharge_req=1;break;case MB_CMD_START_CHARGE:start_charge_req=1;break;case MB_CMD_STOP_CHARGE:stop_charge_req=1;break;case MB_CMD_EMERGENCY_STOP:stop_charge_req=1;stop_discharge_req=1;break;default:return 0;}return 1;
        case MB_REG_SET_OVERC_PROT:overchargeProtectVolt=v;return 1;
        case MB_REG_SET_OVERD_PROT:overdischargeProtectVolt=v;return 1;
        case MB_REG_SET_CYCLE_NUM:cycleDischargeNum=(unsigned char)v;return 1;
        case MB_REG_SET_CHG_VOLT:chargeVoltSet=(unsigned char)v;CHG_VOLT_SET_1=(chargeVoltSet&1)?1:0;CHG_VOLT_SET_2=(chargeVoltSet&2)?1:0;return 1;
        case MB_REG_SET_CHG_CURRENT:chargeCurrentSet=(unsigned char)v;CHG_CURRENT_SET=1;return 1;
        case MB_REG_SET_BAT_TYPE:batteryType=(unsigned char)v;SetChargeParamsByBatteryType();return 1;
    }return 0;
}
static unsigned short read_reg(unsigned short a){
    switch(a){case MB_REG_CMD:return 0;case MB_REG_STATUS_CHARGE:return alarmOvercharge;case MB_REG_STATUS_DISCHARGE:return alarmOverdischarge;case MB_REG_CHARGE_MAH:return curChargeMAH;case MB_REG_DISCHARGE_MAH:return curDischargeMAH;case MB_REG_BAT_VOLT:return curBatVolt;case MB_REG_CHARGE_CURRENT:return curChargeCurrentMA;case MB_REG_DISCHARGE_CURRENT:return curDischargeCurrentMA;case MB_REG_OVERC_PROT:return overchargeProtectVolt;case MB_REG_OVERD_PROT:return overdischargeProtectVolt;case MB_REG_CYCLE_NUM:return curCycleNum;case MB_REG_DEVICE_ID:return MB_DEVICE_ID;case MB_REG_SET_OVERC_PROT:return overchargeProtectVolt;case MB_REG_SET_OVERD_PROT:return overdischargeProtectVolt;case MB_REG_SET_CYCLE_NUM:return cycleDischargeNum;case MB_REG_SET_CHG_VOLT:return chargeVoltSet;case MB_REG_SET_CHG_CURRENT:return chargeCurrentSet;case MB_REG_SET_BAT_TYPE:return batteryType;default:if(a>=MB_REG_CYCLE_DISCH_BASE&&a<MB_REG_CYCLE_DISCH_BASE+10)return cycleDischargeEndMAH[a-MB_REG_CYCLE_DISCH_BASE];if(a>=MB_REG_CYCLE_CHG_BASE&&a<MB_REG_CYCLE_CHG_BASE+10)return cycleChargeEndMAH[a-MB_REG_CYCLE_CHG_BASE];return 0;}
}

/* ========== UART1 ISR ========== */
void UART1_ISR(void) interrupt 4
{
    if(RI){RI=0;mb_ring[mb_ring_wr++]=SBUF;if(mb_ring_wr>=MB_RING_SIZE)mb_ring_wr=0;if(mb_ring_count<MB_RING_SIZE)mb_ring_count++;else{mb_ring_rd=mb_ring_wr;mb_ring_count=MB_RING_SIZE;}mb_last_tick=TimeStamp_GetTick();}
    if(TI){TI=0;mb_tx_done=1;}
}

/* ========== Modbus 帧处理 (从主循环调用) ========== */
void Modbus_Poll(void)
{
    unsigned char i,bc;unsigned short a,n,v,crc;unsigned long now,gap;

    if (mb_ring_count == 0) return;

    /* t3.5 帧间检测 */
    now = TimeStamp_GetTick();
    gap = (now >= mb_last_tick) ? (now - mb_last_tick) : 0;
    if (gap < 50) return;  /* 50 ticks = 5ms @100us */

    /* 帧收齐, 取出 */
    if (mb_ring_count > 250) mb_ring_count = 250;
    for (i = 0; i < mb_ring_count; i++)
        mb_rx_buf[i] = mb_ring[(mb_ring_rd + i) % MB_RING_SIZE];
    i = mb_ring_count;
    mb_ring_rd = mb_ring_wr;
    mb_ring_count = 0;

    if (i < 4) return;

    crc = crc16(mb_rx_buf, i - 2);
    if (crc != (((unsigned short)mb_rx_buf[i-1] << 8) | mb_rx_buf[i-2])) return;

    if (mb_rx_buf[0] != mb_addr && mb_rx_buf[0] != 0) return;

    a = ((unsigned short)mb_rx_buf[2] << 8) | mb_rx_buf[3];
    n = ((unsigned short)mb_rx_buf[4] << 8) | mb_rx_buf[5];

    /* 广播 */
    if (mb_rx_buf[0] == 0) {
        if (mb_rx_buf[1] == 0x06 && i == 8) {
            v = ((unsigned short)mb_rx_buf[4] << 8) | mb_rx_buf[5];
            write_reg(a, v);
        }
        return;
    }

    /* 单播 */
    switch (mb_rx_buf[1]) {
    case 0x03:
        if (i != 8 || n == 0 || n > 64) goto err;
        bc = n * 2;
        mb_tx_buf[0] = mb_addr; mb_tx_buf[1] = 0x03; mb_tx_buf[2] = bc;
        for (i = 0; i < n; i++) {
            v = read_reg(a + i);
            mb_tx_buf[3 + i*2]     = (unsigned char)(v >> 8);
            mb_tx_buf[3 + i*2 + 1] = (unsigned char)(v & 0xFF);
        }
        crc = crc16(mb_tx_buf, 3 + bc);
        mb_tx_buf[3 + bc]     = (unsigned char)(crc & 0xFF);
        mb_tx_buf[3 + bc + 1] = (unsigned char)(crc >> 8);
        uart_send(mb_tx_buf, 3 + bc + 2);
        break;
    case 0x06:
        if (i != 8) goto err;
        v = ((unsigned short)mb_rx_buf[4] << 8) | mb_rx_buf[5];
        if (!write_reg(a, v)) goto err;
        uart_send(mb_rx_buf, 8);
        break;
    case 0x10:
        if (i < 9 || mb_rx_buf[6] != n * 2) goto err;
        for (i = 0; i < n; i++) {
            v = ((unsigned short)mb_rx_buf[7 + i*2] << 8) | mb_rx_buf[8 + i*2];
            if (!write_reg(a + i, v)) goto err;
        }
        mb_tx_buf[0] = mb_addr; mb_tx_buf[1] = 0x10;
        mb_tx_buf[2] = mb_rx_buf[2]; mb_tx_buf[3] = mb_rx_buf[3];
        mb_tx_buf[4] = mb_rx_buf[4]; mb_tx_buf[5] = mb_rx_buf[5];
        crc = crc16(mb_tx_buf, 6);
        mb_tx_buf[6] = (unsigned char)(crc & 0xFF);
        mb_tx_buf[7] = (unsigned char)(crc >> 8);
        uart_send(mb_tx_buf, 8);
        break;
    default:
        goto exf;
    }
    return;

err:
    mb_tx_buf[0] = mb_addr;
    mb_tx_buf[1] = mb_rx_buf[1] | 0x80;
    mb_tx_buf[2] = 0x02;
    goto ex;
exf:
    mb_tx_buf[0] = mb_addr;
    mb_tx_buf[1] = mb_rx_buf[1] | 0x80;
    mb_tx_buf[2] = 0x01;
ex:
    crc = crc16(mb_tx_buf, 3);
    mb_tx_buf[3] = (unsigned char)(crc & 0xFF);
    mb_tx_buf[4] = (unsigned char)(crc >> 8);
    uart_send(mb_tx_buf, 5);
}

/* ========== 初始化 ========== */
void Modbus_Init(unsigned char addr)
{
    if(addr==0){unsigned char hw=0;hw|=(ADDR_0)?0x01:0x00;hw|=(ADDR_1)?0x02:0x00;hw|=(ADDR_2)?0x04:0x00;hw|=(ADDR_3)?0x08:0x00;hw|=(ADDR_4)?0x10:0x00;mb_addr=hw+1;}else mb_addr=addr;
    mb_ring_wr=0;mb_ring_rd=0;mb_ring_count=0;mb_last_tick=0;
}
unsigned char Modbus_GetAddr(void){return mb_addr;}
